#include <Scheduler.h>
#include <Arduino.h>
#include <Wire.h>
#include <SPI.h>
#include <Adafruit_GFX.h> //OLED libraries
#include <Adafruit_SSD1306.h>
#include <Arduino_LSM9DS1.h> // accelerometer library
#include "algorithm_by_RF.h"
#include "max30102.h"

//#define DEBUG // uncomment to print to serial monitor

float at; // total acceleration

#define SCREEN_WIDTH 128 // OLED display width, in pixels
#define SCREEN_HEIGHT 32 // OLED display height, in pixels
#define OLED_RESET    -1 // Reset pin # (or -1 if sharing Arduino reset pin)
Adafruit_SSD1306 oled(SCREEN_WIDTH, SCREEN_HEIGHT, &Wire, OLED_RESET); //Declaring the display name (display)

//Logo2 and Logo3 are two bmp pictures that display on the OLED if called
static const unsigned char PROGMEM logo2_bmp[] =
{ 0x03, 0xC0, 0xF0, 0x06, 0x71, 0x8C, 0x0C, 0x1B, 0x06, 0x18, 0x0E, 0x02, 0x10, 0x0C, 0x03, 0x10,
0x04, 0x01, 0x10, 0x04, 0x01, 0x10, 0x40, 0x01, 0x10, 0x40, 0x01, 0x10, 0xC0, 0x03, 0x08, 0x88,
0x02, 0x08, 0xB8, 0x04, 0xFF, 0x37, 0x08, 0x01, 0x30, 0x18, 0x01, 0x90, 0x30, 0x00, 0xC0, 0x60,
0x00, 0x60, 0xC0, 0x00, 0x31, 0x80, 0x00, 0x1B, 0x00, 0x00, 0x0E, 0x00, 0x00, 0x04, 0x00,  };

static const unsigned char PROGMEM logo3_bmp[] =
{ 0x01, 0xF0, 0x0F, 0x80, 0x06, 0x1C, 0x38, 0x60, 0x18, 0x06, 0x60, 0x18, 0x10, 0x01, 0x80, 0x08,
0x20, 0x01, 0x80, 0x04, 0x40, 0x00, 0x00, 0x02, 0x40, 0x00, 0x00, 0x02, 0xC0, 0x00, 0x08, 0x03,
0x80, 0x00, 0x08, 0x01, 0x80, 0x00, 0x18, 0x01, 0x80, 0x00, 0x1C, 0x01, 0x80, 0x00, 0x14, 0x00,
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0x00, 0x08, 0x10, 0x00, 0x00, 0x06, 0x60, 0x00, 0x00, 0x03, 0xC0, 0x00, 0x00, 0x01, 0x80, 0x00  };

static const unsigned char PROGMEM meme_bmp[] = 
{
0xff, 0xff, 0xff, 0xff, 0xff, 0xff, 0xff, 0xff, 0xff, 0xff, 0xff, 0xff, 0xff, 0xff, 0xff, 0xff, 
0xff, 0xff, 0xff, 0xff, 0xff, 0xff, 0xff, 0xff, 0xff, 0xff, 0xff, 0xff, 0xff, 0xff, 0xff, 0xff, 
0xff, 0xff, 0xff, 0xff, 0xff, 0xff, 0xff, 0xff, 0xff, 0xff, 0xff, 0xff, 0xff, 0xff, 0xff, 0xff, 
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0xff, 0xff, 0xff, 0xff, 0xff, 0xff, 0xff, 0xff, 0xff, 0xff, 0xff, 0xff, 0xff, 0xff, 0xff, 0xff
};

// Interrupt pin
const byte oxiInt = 3; // pin connected to MAX30102 INT

const byte warningLED = 22; // red led
const byte readLED = 23; // green led
const byte fallLED = 24; // blue led

uint32_t aun_ir_buffer[BUFFER_SIZE]; //infrared LED sensor data
uint32_t aun_red_buffer[BUFFER_SIZE];  //red LED sensor data
float old_n_spo2;  // Previous SPO2 value
uint8_t uch_dummy, k;

void setup() {
  
  pinMode(readLED, OUTPUT);
  pinMode(warningLED, OUTPUT);
  pinMode(fallLED, OUTPUT);
  pinMode(2, OUTPUT); // Set buzzer - pin 2 as an output
  
#ifdef DEBUG
  Serial.begin(115200);
#endif
  if (!IMU.begin()) {
#ifdef DEBUG    
    Serial.println("Failed to initialize IMU!");
#endif    
    while (1);
  }
  oled.begin(SSD1306_SWITCHCAPVCC, 0x3C);
  oled.display();
//  delay(3000);

  Wire.begin();
  maxim_max30102_reset(); //resets the MAX30102
  delay(1000);
  maxim_max30102_read_reg(REG_INTR_STATUS_1, &uch_dummy); //Reads/clears the interrupt status register
  maxim_max30102_init();  //initialize the MAX30102
  old_n_spo2 = 0.0;
  
  Scheduler.startLoop(loop2);
}

void loop2() {
  float ax, ay, az; // 3-axis accel data
  if (IMU.accelerationAvailable()) {
    IMU.readAcceleration(ax, ay, az);
    at = sqrt(ax*ax + ay*ay + az*az);
//    Serial.println(at);
    delay(200);
  }
}

void loop() {
  float n_spo2, ratio, correl; //SPO2 value
  int8_t ch_spo2_valid;  //indicator to show if the SPO2 calculation is valid
  int32_t n_heart_rate; //heart rate value
  int8_t  ch_hr_valid;  //indicator to show if the heart rate calculation is valid
  int32_t i;

  noTone(2);
  
  while (at > 0.7) {
    digitalWrite(fallLED, HIGH);
    for (i = 0; i < 100; i++)
    {
      //    while(digitalRead(oxiInt)==1);  //wait until the interrupt pin asserts
      maxim_max30102_read_fifo((aun_red_buffer+i), (aun_ir_buffer+i));  //read from MAX30102 FIFO
      digitalWrite(readLED, !digitalRead(readLED)); //Blink onboard LED with every data read
    }
  
    rf_heart_rate_and_oxygen_saturation(aun_ir_buffer, BUFFER_SIZE, aun_red_buffer, &n_spo2, &ch_spo2_valid, &n_heart_rate, &ch_hr_valid, &ratio, &correl);
  
#ifdef DEBUG
    Serial.println("--RF--");
    Serial.print("\t");
    Serial.print(n_spo2);
    Serial.print("\t");
    Serial.print(n_heart_rate, DEC);
    Serial.print("\t");
    Serial.println("------");
#endif

    if (ch_hr_valid && ch_spo2_valid) {
      oled.clearDisplay();
      oled.setTextSize(3);
      oled.setTextColor(WHITE);
      oled.setCursor(0,0);
      oled.print(n_spo2, 1); oled.println(" %");
      oled.display();
      old_n_spo2 = n_spo2;
      if (n_spo2 < 89) {
        digitalWrite(warningLED, LOW);
        tone(2,200,500);
      }
      else {
        digitalWrite(warningLED, HIGH);
        noTone(2);
      }
    }
  } // end of while( fall detect );
  digitalWrite(fallLED, LOW);
  oled.clearDisplay();
  oled.setTextSize(2);
  oled.setTextColor(WHITE);
  oled.setCursor(0, 0);
  oled.println("FALL"); oled.println("DETECTED!");
  oled.display();
  tone(2,200,500);
  delay(1000);
  yield();
}
